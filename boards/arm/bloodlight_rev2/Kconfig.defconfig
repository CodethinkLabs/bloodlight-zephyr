## boards/arm/bloodlight_rev2/Kconfig.defconfig
```kconfig
# STM32G474RE Nucleo board configuration

# Copyright (c) 2019 STMicroelectronics.
# SPDX-License-Identifier: Apache-2.0

if BOARD_BLOODLIGHT_REV2

config BOARD
	default "bloodlight_rev2"

config SPI_STM32_INTERRUPT
	default y
	depends on SPI

endif


config PRINTK
    bool "Send printk() to console"
    default y

config USB_DEVICE_VID
	hex "USB Vendor ID"
	default 0x0483
	depends on USB
    help
      USB device vendor ID. MUST be configured by vendor.
config USB_DEVICE_PID
	hex "USB Product ID"
	default 0x5740
	depends on USB
    help
      USB device product ID. MUST be configured by vendor.
```

## boards/arm/bloodlight_rev2/bloodlight_rev2_defconfig
```kconfig
# SPDX-License-Identifier: Apache-2.0

CONFIG_SOC_SERIES_STM32G4X=y
CONFIG_SOC_STM32G474XX=y

# enable uart driver
CONFIG_SERIAL=y

# enable pinmux
CONFIG_PINMUX=y

# enable GPIO
CONFIG_GPIO=y

# Enable Clocks
CONFIG_CLOCK_CONTROL=y

# Enable MPU
CONFIG_ARM_MPU=y

# Enable HW stack protection
CONFIG_HW_STACK_PROTECTION=y

# Serial and USB
CONFIG_SERIAL=y
CONFIG_USB=y
CONFIG_USB_DC_STM32=y
CONFIG_USB_CDC_ACM=y
CONFIG_USB_DEVICE_STACK=y
CONFIG_UART_INTERRUPT_DRIVEN=y
```

## tests/led/testcase.yaml
```yaml
tests:
  testing.ztest:
    build_only: true
    platform_allow: bloodlight_rev2
    tags: testing
```
